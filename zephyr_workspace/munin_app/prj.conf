## CMakeLists.txt
```
cmake_minimum_required(VERSION 3.20.0)

find_package(Zephyr REQUIRED HINTS $ENV{ZEPHYR_BASE})
project(munin)

target_sources(app PRIVATE src/main.c)
target_sources(app PRIVATE src/munin_protocol.c)
target_sources(app PRIVATE src/ble.c)
target_sources(app PRIVATE src/imu.c)
target_sources(app PRIVATE src/battery.c)
target_sources(app PRIVATE src/led_config.c)
target_sources(app PRIVATE src/led_effects.c)
target_sources(app PRIVATE src/sk6812.c)
```

## prj.conf
```kconfig
# GPIO (blink etc.)
CONFIG_GPIO=y

# ADC for battery monitoring
CONFIG_ADC=y
CONFIG_ADC_NRFX_SAADC=y

# USB device + CDC ACM (LEGACY stack)
CONFIG_USB_DEVICE_STACK=y
CONFIG_USB_DEVICE_STACK_NEXT=n
CONFIG_USB_DEVICE_INITIALIZE_AT_BOOT=y
CONFIG_USB_CDC_ACM=y

# Console routed to the CDC ACM UART via chosen node
CONFIG_CONSOLE=y
CONFIG_PRINTK=y
CONFIG_SERIAL=y
CONFIG_UART_LINE_CTRL=y
CONFIG_UART_CONSOLE=y

# BLE
CONFIG_BT=y
CONFIG_BT_PERIPHERAL=y
CONFIG_BT_DEVICE_NAME="Munin"
# Simplify identity handling and avoid privacy rotation until basic adv works
CONFIG_BT_PRIVACY=n
CONFIG_BT_ID_MAX=1

# GATT
CONFIG_BT_GATT_CLIENT=y
CONFIG_BT_SETTINGS=y
CONFIG_SETTINGS=y
CONFIG_SETTINGS_NVS=y
CONFIG_FLASH=y
CONFIG_FLASH_MAP=y
CONFIG_NVS=y

# BLE Battery Service
CONFIG_BT_BAS=y
CONFIG_BT_BAS_BLS=y
CONFIG_BT_BAS_BLS_BATTERY_LEVEL_PRESENT=y
CONFIG_BT_BAS_BLS_ADDITIONAL_STATUS_PRESENT=y

# Sensors (IMU)
CONFIG_I2C=y
CONFIG_SENSOR=y
CONFIG_LSM6DSL=y

# Logging
CONFIG_LOG=y
CONFIG_LOG_DEFAULT_LEVEL=3
```

## src/main.c
```c
// Stub for missing function to allow build
void wait_for_dtr(const struct device *dev) {
	(void)dev;
}

// Stub for missing function to allow build
static void munin_send_version_packet(void) {
	/* No-op stub */
}

#include <zephyr/sys/util.h> // For ARG_UNUSED
#include "led_effects.h"
#include "led_config.h"
#include "ble.h"
#include "imu.h"
#include "battery.h"
#include "munin_protocol.h"
#include "debug.h"

// Prototypes for local functions
static void munin_send_version_packet(void);


#ifndef MUNIN_DEBUG
#define MUNIN_DEBUG 0
#endif
#include <zephyr/kernel.h>
#include <zephyr/drivers/gpio.h>
#include <zephyr/sys/printk.h>
#include <zephyr/drivers/uart.h>
#include <zephyr/device.h>
#include <zephyr/devicetree.h>
#include <zephyr/settings/settings.h>
#include <zephyr/bluetooth/services/bas.h>

#include "ble.h"
#include "imu.h"
#include "battery.h"
#include "munin_protocol.h"
#include "led_config.h"
int main(void)
{
	printk("=== Munin (Zephyr) BOOT ===\n");
	const struct device *console = DEVICE_DT_GET_OR_NULL(DT_CHOSEN(zephyr_console));
	int ret;

	printk("Console: %p\n", console);

	// LED target selection is now handled in led_effects_init and can be changed at runtime
	// Default is SK6812, fallback to onboard RGB if not present
	if (munin_led_effects_init()) {
		printk("LED effects init failed\n");
	}

	printk("Munin: after led_effects_init\n");

	if (console && device_is_ready(console)) {
		wait_for_dtr(console);
	}
	printk("Console ready. Initializing subsystems...\n");

	// Init settings subsystem first (required for BLE persistent identity)
	int settings_err = settings_subsys_init();
	if (settings_err) {
		printk("Settings subsystem init failed: %d\n", settings_err);
	} else {
		int load_ret = settings_load();
		printk("Settings load result: %d\n", load_ret);
	}

	// Init other subsystems
	if (munin_battery_init()) printk("Battery init failed\n");
	if (munin_imu_init()) printk("IMU init failed\n");
	if (munin_ble_init()) printk("BLE init failed\n");

	printk("Munin: after all subsystem init\n");

	/* Send version packet once BLE is up (client can log firmware version) */
	munin_send_version_packet();

	// Main loop
	int counter = 0;
	while (1) {
		uint8_t current_face = munin_imu_get_current_face();
		const munin_rgb_t *colors = munin_led_get_face_colors();
		munin_rgb_t c = colors[(current_face ? current_face : 1) - 1];

		munin_led_effects_update();

		/* Reduce console spam: only log every 20 iterations (~10s) when debug enabled */
		if (MUNIN_DEBUG && (counter % 20 == 0)) {
			printk("tick %d face=%u color=%u,%u,%u batt=%u%% conn=%d adv=%d\n", counter, current_face,
				   c.r, c.g, c.b,
				   munin_battery_get_percentage(), munin_ble_is_connected(), munin_ble_is_advertising());
		}
		counter++;

		munin_battery_update();
		munin_imu_update();
		munin_ble_update();

		k_sleep(K_MSEC(500));
	}
	return 0;
}
```

## src/battery.c
```c
#include "battery.h"
#include "munin_protocol.h"
#include <zephyr/kernel.h>
#include <zephyr/pm/device.h>
#include <zephyr/drivers/adc.h>
#include <zephyr/drivers/gpio.h>
#include <zephyr/device.h>
#include <zephyr/bluetooth/services/bas.h>
#include <hal/nrf_saadc.h>
#include "debug.h"

/* ADC configuration for battery voltage reading */
#define ADC_NODE DT_NODELABEL(adc)
#define ADC_RESOLUTION 12
#define ADC_GAIN ADC_GAIN_1_6
#define ADC_REFERENCE ADC_REF_INTERNAL
#define ADC_ACQUISITION_TIME ADC_ACQ_TIME_DEFAULT

/* Battery voltage divider configuration for XIAO BLE Sense */
#define BATTERY_ADC_CHANNEL 2  /* P0.31/AIN2 used for battery voltage */

/* Charging detection GPIO - P0.17 on XIAO BLE Sense (CHG pin) */
#define CHARGE_GPIO_NODE DT_NODELABEL(gpio0)
#define CHARGE_PIN 17

static const struct device *adc_dev;
static const struct device *gpio_dev;
static struct adc_channel_cfg m_1st_channel_cfg = {
    .gain = ADC_GAIN_1_6,
    .reference = ADC_REF_INTERNAL,
    .acquisition_time = ADC_ACQ_TIME_DEFAULT,
    .channel_id = BATTERY_ADC_CHANNEL,
    #if CONFIG_ADC_NRFX_SAADC
    .input_positive = NRF_SAADC_INPUT_AIN2,  /* P0.31 */
    #endif
};

static uint16_t s_mv = 4000;
static uint8_t s_pct = 100;
static bool s_chg = false;

/* Convert raw battery voltage (mV) to percentage (0-100)
 * Based on typical LiPo discharge curve for 3.7V nominal battery (EEMB 803030)
 * LiPo discharge curve: 4.2V (100%) -> 3.7V (50%) -> 3.0V (0%)
 */
static uint8_t voltage_to_percentage(uint16_t mv, bool is_charging)
{
    ARG_UNUSED(is_charging);
    static const struct { uint16_t mv; uint8_t pct; } table[] = {
        {3620,100},{3550,90},{3500,75},{3450,60},{3400,45},{3350,30},{3300,20},{3250,10},{3200,5},{3000,0}
    };
    for (size_t i = 0; i < (sizeof(table)/sizeof(table[0])); i++) {
        if (mv >= table[i].mv) return table[i].pct;
    }
    return 0;
}

/* Read battery voltage via ADC using proven XIAO BLE Sense approach */
static int read_battery_voltage(uint16_t *mv)
{
    const int num_samples = 8;  /* Average 8 readings for stability */
    int32_t sum = 0;
    
    struct adc_sequence sequence = {
        .channels = BIT(BATTERY_ADC_CHANNEL),
        .buffer_size = sizeof(int16_t),
        .resolution = ADC_RESOLUTION,
    };

    /* Take multiple samples and average them */
    for (int i = 0; i < num_samples; i++) {
        int16_t buf;
        sequence.buffer = &buf;
        
        int ret = adc_read(adc_dev, &sequence);
        if (ret < 0) {
            printk("Battery: ADC read failed: %d\n", ret);
            return ret;
        }
        
        sum += buf;
        
        /* Small delay between samples to reduce noise correlation */
        k_msleep(2);
    }
    
    /* Calculate average */
    int16_t avg_raw = sum / num_samples;
    
    /* Direct empirical calibration based on your measurement
     * Your multimeter: 3.62V
     * Our ADC reading: ~260 raw → ~670mV calculated  
     * Calibration factor needed: 3620mV / 670mV = 5.4
     */
    float vbat_raw = (float)avg_raw / 4096.0 * 3.6 * 2.96;
    float vbat_calibrated = vbat_raw * 5.4;  /* Apply empirical correction */
    *mv = (uint16_t)(vbat_calibrated * 1000);  /* Convert to millivolts */
    
    /* Debug output to understand ADC readings */
    MLOG("Battery: raw=%d avg_of=%d uncal=%dmV cal=%dmV\n", (int)avg_raw, num_samples, (int)(vbat_raw * 1000), (int)*mv);

    return 0;
}

/* Check charging status via GPIO */
static bool read_charging_status(void)
{
    /* On XIAO BLE Sense, charging pin goes LOW when charging */
    int val = gpio_pin_get(gpio_dev, CHARGE_PIN);
    return (val == 0);  /* Active low */
}

int munin_battery_init(void)
{
    printk("Battery: Initializing ADC and GPIO...\n");
    
    /* Get ADC device */
    adc_dev = DEVICE_DT_GET(ADC_NODE);
    if (!device_is_ready(adc_dev)) {
        printk("Battery: ADC device not ready\n");
        return -1;
    }

    /* Configure ADC channel */
    int ret = adc_channel_setup(adc_dev, &m_1st_channel_cfg);
    if (ret < 0) {
        printk("Battery: ADC channel setup failed: %d\n", ret);
        return ret;
    }

    /* Get GPIO device for charging detection */
    gpio_dev = DEVICE_DT_GET(CHARGE_GPIO_NODE);
    if (!device_is_ready(gpio_dev)) {
        printk("Battery: GPIO device not ready\n");
        return -1;
    }

    /* Configure charging detection pin as input with pull-up */
    ret = gpio_pin_configure(gpio_dev, CHARGE_PIN, GPIO_INPUT | GPIO_PULL_UP);
    if (ret < 0) {
        printk("Battery: Charge pin configure failed: %d\n", ret);
        return ret;
    }

    /* Enable battery voltage divider by setting P0.14 low (as per XIAO BLE Sense forum solution) */
    ret = gpio_pin_configure(gpio_dev, 14, GPIO_OUTPUT);
    if (ret < 0) {
        printk("Battery: P0.14 configure failed: %d\n", ret);
        return ret;
    }
    ret = gpio_pin_set(gpio_dev, 14, 0);  /* Set P0.14 low to enable voltage divider */
    if (ret < 0) {
        printk("Battery: P0.14 set low failed: %d\n", ret);
        return ret;
    }
    printk("Battery: Enabled voltage divider via P0.14\n");

    /* Read initial battery status */
    uint16_t mv;
    if (read_battery_voltage(&mv) == 0) {
        s_mv = mv;
        s_chg = read_charging_status();
        s_pct = voltage_to_percentage(mv, s_chg);
        printk("Battery: %dmV %d%% (%s)\n", s_mv, s_pct, s_chg?"chg":"disc");
    }

    s_chg = read_charging_status();
    MLOG("Battery: Initial charging status=%s\n", s_chg ? "charging" : "not charging");

    /* Initialize BLE Battery Service */
    bt_bas_set_battery_level(s_pct);
    bt_bas_bls_set_battery_present(BT_BAS_BLS_BATTERY_PRESENT);

    printk("Battery: Initialization complete\n");
    return 0;
}

void munin_battery_update(void)
{
    static int64_t last_update;
    static int64_t last_broadcast;
    int64_t now = k_uptime_get();
    
    /* Update battery readings every 10 seconds for more responsive charging detection */
    if (now - last_update < 10000) {
        return; 
    }
    last_update = now;

    /* Read current battery voltage */
    uint16_t mv_new;
    bool chg_new = read_charging_status();
    if (read_battery_voltage(&mv_new) == 0) {
        s_mv = mv_new;
        s_pct = voltage_to_percentage(mv_new, chg_new);
        
        /* Update standard BLE Battery Service */
        bt_bas_set_battery_level(s_pct);
    }

    /* Check charging status */
    if (chg_new != s_chg) {
        s_chg = chg_new;
        if (s_chg) {
        printk("Battery: Charging started\n");
        } else {
            printk("Battery: Charging stopped\n");
        }
        
        /* Note: Advanced BLE Battery Service charging state features not available in this Zephyr version */
    }

    static bool low_sent = false;
    static bool full_sent = false;
    const uint16_t LOW_THRESH_MV = 3200;
    const uint16_t FULL_THRESH_MV = 4170; /* Consider ~4.17V effectively full */

    /* Charging transition events */
    if (chg_new != s_chg) {
        bool was_charging = s_chg;
        s_chg = chg_new;
        munin_packet_t pkt;
        if (s_chg) {
            /* Charging started */
            munin_protocol_create_packet(&pkt, MUNIN_EVENT_CHARGING_STARTED, 0, 0);
            munin_protocol_send_packet(&pkt);
            printk("Battery: Charging started\n");
            full_sent = false; /* allow new full notification */
        } else {
            munin_protocol_create_packet(&pkt, MUNIN_EVENT_CHARGING_STOPPED, 0, 0);
            munin_protocol_send_packet(&pkt);
            printk("Battery: Charging stopped\n");
        }
    }

    /* Low battery one-shot (until voltage rises above hysteresis) */
    if (!s_chg && s_mv <= LOW_THRESH_MV) {
        if (!low_sent) {
            munin_packet_t pkt;
            munin_protocol_create_packet(&pkt, MUNIN_EVENT_LOW_BATTERY, s_mv/10, s_pct);
            munin_protocol_send_packet(&pkt);
            printk("Battery: LOW BATTERY (<=%dmV) %dmV %d%%\n", LOW_THRESH_MV, s_mv, s_pct);
            low_sent = true;
        }
    } else if (s_mv > (LOW_THRESH_MV + 80)) { /* ~80mV hysteresis */
        low_sent = false;
    }

    /* Full battery (while charging) */
    if (s_chg && s_mv >= FULL_THRESH_MV) {
        if (!full_sent) {
            munin_packet_t pkt;
            munin_protocol_create_packet(&pkt, MUNIN_EVENT_FULLY_CHARGED, s_mv/10, s_pct);
            munin_protocol_send_packet(&pkt);
            printk("Battery: Fully charged (%dmV)\n", s_mv);
            full_sent = true;
        }
    }

    /* Broadcast battery status every 5 minutes (300s) */
    if (now - last_broadcast >= 300000) {
        last_broadcast = now;
        printk("Battery: Broadcast %dmV %d%% %s\n", s_mv, s_pct, s_chg?"chg":"disc");
        munin_packet_t pkt;
        uint32_t voltage_encoded = s_mv / 10;  /* Encode voltage in 10mV units */
        uint8_t status_encoded = s_pct | (s_chg ? 0x80 : 0x00);  /* MSB = charging flag */
        munin_protocol_create_packet(&pkt, MUNIN_EVENT_BATTERY_STATUS, voltage_encoded, status_encoded);
        munin_protocol_send_packet(&pkt);
    }

    /* Periodic battery status logging */
    MLOG("Battery: periodic %dmV %d%% %s\n", s_mv, s_pct, s_chg?"chg":"disc");
}

uint16_t munin_battery_get_voltage_mv(void) { return s_mv; }
uint8_t munin_battery_get_percentage(void) { return s_pct; }
bool munin_battery_is_charging(void) { return s_chg; }
```

## src/battery.h
```c
#ifndef MUNIN_BATTERY_H
#define MUNIN_BATTERY_H

#include <stdint.h>
#include <stdbool.h>

int munin_battery_init(void);
void munin_battery_update(void);
uint16_t munin_battery_get_voltage_mv(void);
uint8_t munin_battery_get_percentage(void);
bool munin_battery_is_charging(void);

#endif
```

## src/ble.c
```c
// Clean, fixed implementation
#include "ble.h"
#include <string.h>
#include <zephyr/kernel.h>
#include <zephyr/bluetooth/bluetooth.h>
#include <zephyr/bluetooth/hci.h>
#include <zephyr/bluetooth/conn.h>
#include <zephyr/bluetooth/uuid.h>
#include <zephyr/bluetooth/gatt.h>
#include <zephyr/bluetooth/addr.h>
#include <zephyr/settings/settings.h>

// Custom 128-bit UUIDs
#define MUNIN_SVC_UUID    BT_UUID_128_ENCODE(0x6e400001, 0x8a3a, 0x11e5, 0x8994, 0xfeff819cdc9f)
#define MUNIN_TX_UUID     BT_UUID_128_ENCODE(0x6e400002, 0x8a3a, 0x11e5, 0x8994, 0xfeff819cdc9f) /* Generic data / legacy */
#define MUNIN_LED_UUID    BT_UUID_128_ENCODE(0x6e400003, 0x8a3a, 0x11e5, 0x8994, 0xfeff819cdc9f) /* Placeholder write */
#define MUNIN_FACE_UUID   BT_UUID_128_ENCODE(0x6e400004, 0x8a3a, 0x11e5, 0x8994, 0xfeff819cdc9f) /* New face notify */

static struct bt_uuid_128 svc_uuid  = BT_UUID_INIT_128(MUNIN_SVC_UUID);
static struct bt_uuid_128 tx_uuid   = BT_UUID_INIT_128(MUNIN_TX_UUID);
static struct bt_uuid_128 led_uuid  = BT_UUID_INIT_128(MUNIN_LED_UUID);
static struct bt_uuid_128 face_uuid = BT_UUID_INIT_128(MUNIN_FACE_UUID);

static struct bt_conn *s_conn;
static uint8_t tx_value[8]; /* small generic buffer */
static uint8_t face_value;  /* last notified face */
static bool ble_connected;
static bool ble_advertising;
static bool face_notif_enabled; /* client subscribed */

/* Debounced confirmation sweep state */
struct confirm_seq_state {
    bool armed;          /* armed by recent writes */
    bool active;         /* sequence currently running */
    int64_t last_rx_ms;  /* time of last write */
    uint8_t next_face;   /* next face in 1..6 */
    int64_t step_ms;     /* time when current step started */
    bool in_break;       /* true when in off pause */
    bool preflash_done;  /* whether we already showed current face immediately */
    uint8_t preflash_face; /* current face to show immediately, 0 to skip */
};
static struct confirm_seq_state s_cseq;

/* Attribute index map (order produced by BT_GATT_SERVICE_DEFINE) */
#define MUNIN_SVC_ATTR_PRIMARY     0
#define MUNIN_SVC_ATTR_TX_DECL     1
#define MUNIN_SVC_ATTR_TX_VALUE    2
#define MUNIN_SVC_ATTR_TX_CCC      3
#define MUNIN_SVC_ATTR_FACE_DECL   4
#define MUNIN_SVC_ATTR_FACE_VALUE  5
#define MUNIN_SVC_ATTR_FACE_CCC    6
#define MUNIN_SVC_ATTR_LED_DECL    7
#define MUNIN_SVC_ATTR_LED_VALUE   8

static ssize_t read_tx(struct bt_conn *conn, const struct bt_gatt_attr *attr,
                       void *buf, uint16_t len, uint16_t offset)
{
    return bt_gatt_attr_read(conn, attr, buf, len, offset, tx_value, sizeof(tx_value));
}

static ssize_t read_face(struct bt_conn *conn, const struct bt_gatt_attr *attr,
                         void *buf, uint16_t len, uint16_t offset)
{
    /* Always return the current face from IMU */
    extern uint8_t munin_imu_get_current_face(void);
    face_value = munin_imu_get_current_face();
    return bt_gatt_attr_read(conn, attr, buf, len, offset, &face_value, sizeof(face_value));
}

static ssize_t write_led(struct bt_conn *conn, const struct bt_gatt_attr *attr,
                         const void *buf, uint16_t len, uint16_t offset, uint8_t flags)
{
    ARG_UNUSED(conn); ARG_UNUSED(attr); ARG_UNUSED(flags);
    if (offset != 0) {
        return BT_GATT_ERR(BT_ATT_ERR_INVALID_OFFSET);
    }
    if (len != 4) {
        return BT_GATT_ERR(BT_ATT_ERR_INVALID_ATTRIBUTE_LEN);
    }

    const uint8_t *p = (const uint8_t *)buf;
    uint8_t face = p[0];
    if (face < 1 || face > 6) {
        return BT_GATT_ERR(BT_ATT_ERR_VALUE_NOT_ALLOWED);
    }

    /* Log receipt of face color configuration packet */
    printk("cfg face=%u rgb=%u,%u,%u\n", face, p[1], p[2], p[3]);
    extern void munin_led_set_face_color(uint8_t face, uint8_t r, uint8_t g, uint8_t b);
    munin_led_set_face_color(face, p[1], p[2], p[3]);

    /* Arm a debounced confirmation sweep; will start after a short idle */
    s_cseq.armed = true;
    s_cseq.last_rx_ms = k_uptime_get();
    return len;
}

/* CCC callback for face notifications */
static void face_ccc_cfg_changed(const struct bt_gatt_attr *attr, uint16_t value)
{
    face_notif_enabled = (value == BT_GATT_CCC_NOTIFY);
    printk("[BLE] Face notifications %s\n", face_notif_enabled ? "ENABLED" : "DISABLED");
    
    /* When notifications are enabled, send current face after a short delay */
    if (face_notif_enabled && ble_connected && s_conn) {
        /* We'll send the current face in munin_ble_update() */
        printk("[BLE] Will send current face on next update\n");
    }
}

BT_GATT_SERVICE_DEFINE(munin_svc,
    BT_GATT_PRIMARY_SERVICE(&svc_uuid),
    /* Generic tiny data characteristic (legacy) */
    BT_GATT_CHARACTERISTIC(&tx_uuid.uuid,
        BT_GATT_CHRC_READ | BT_GATT_CHRC_NOTIFY,
        BT_GATT_PERM_READ,
        read_tx, NULL, tx_value),
    BT_GATT_CCC(NULL, BT_GATT_PERM_READ | BT_GATT_PERM_WRITE),
    /* Face state characteristic: read current face & subscribe */
    BT_GATT_CHARACTERISTIC(&face_uuid.uuid,
        BT_GATT_CHRC_READ | BT_GATT_CHRC_NOTIFY,
        BT_GATT_PERM_READ,
        read_face, NULL, &face_value),
    BT_GATT_CCC(face_ccc_cfg_changed, BT_GATT_PERM_READ | BT_GATT_PERM_WRITE),
    /* LED control placeholder */
    BT_GATT_CHARACTERISTIC(&led_uuid.uuid,
        BT_GATT_CHRC_WRITE,
        BT_GATT_PERM_WRITE,
        NULL, write_led, NULL),
);

static void connected(struct bt_conn *conn, uint8_t err)
{
    if (err) {
        printk("[BLE] Connection failed (%u)\n", err);
        return;
    }
    s_conn = bt_conn_ref(conn);
    ble_connected = true;
    printk("[BLE] Connected\n");
}

static void disconnected(struct bt_conn *conn, uint8_t reason)
{
    ARG_UNUSED(conn);
    printk("[BLE] Disconnected (reason 0x%02x)\n", reason);
    if (s_conn) {
        bt_conn_unref(s_conn);
        s_conn = NULL;
    }
    ble_connected = false;
    /* Cancel any pending confirmation sequence */
    memset(&s_cseq, 0, sizeof(s_cseq));
}

BT_CONN_CB_DEFINE(conn_cbs) = {
    .connected = connected,
    .disconnected = disconnected,
};

static const struct bt_data ad[] = {
    BT_DATA_BYTES(BT_DATA_FLAGS, (BT_LE_AD_GENERAL | BT_LE_AD_NO_BREDR)),
    BT_DATA(BT_DATA_NAME_COMPLETE, CONFIG_BT_DEVICE_NAME, sizeof(CONFIG_BT_DEVICE_NAME) - 1),
    BT_DATA_BYTES(BT_DATA_UUID128_ALL, MUNIN_SVC_UUID),
};

static const struct bt_le_adv_param adv_params = BT_LE_ADV_PARAM_INIT(
    BT_LE_ADV_OPT_CONNECTABLE,
    BT_GAP_ADV_FAST_INT_MIN_2,
    BT_GAP_ADV_FAST_INT_MAX_2,
    NULL
);

int munin_ble_init(void)
{
    printk("[BLE] Init start\n");

    /* Ensure an identity exists BEFORE enabling controller if settings did not provide one */
    bt_addr_le_t addrs_pre[CONFIG_BT_ID_MAX];
    size_t pre_cnt = ARRAY_SIZE(addrs_pre);
    bt_id_get(addrs_pre, &pre_cnt);
    if (pre_cnt == 0) {
        /* Create a deterministic static random address (C0:FF:EE:12:34:56) */
        bt_addr_le_t static_id = { .type = BT_ADDR_LE_RANDOM };
        static_id.a.val[0] = 0x56;
        static_id.a.val[1] = 0x34;
        static_id.a.val[2] = 0x12;
        static_id.a.val[3] = 0xEE;
        static_id.a.val[4] = 0xFF;
        static_id.a.val[5] = 0xC0; /* Top two bits 1 1 => static random */
        int id_ret = bt_id_create(&static_id, NULL);
        if (id_ret < 0) {
            printk("[BLE] bt_id_create (pre-enable) failed: %d\n", id_ret);
        } else {
            printk("[BLE] Created static identity (pre-enable) id=%d\n", id_ret);
        }
    }

    int err = bt_enable(NULL); // synchronous
    if (err) {
        printk("[BLE] bt_enable failed: %d\n", err);
        return err;
    }
    printk("[BLE] bt_enable OK\n");

    bt_addr_le_t addrs[CONFIG_BT_ID_MAX];
    size_t count = ARRAY_SIZE(addrs);
    bt_id_get(addrs, &count);
    printk("[BLE] Identity count: %u\n", (unsigned)count);
    for (size_t i = 0; i < count; i++) {
        char buf[BT_ADDR_LE_STR_LEN];
        bt_addr_le_to_str(&addrs[i], buf, sizeof(buf));
        printk("[BLE] ID %u: %s\n", (unsigned)i, buf);
    }

    err = bt_le_adv_start(&adv_params, ad, ARRAY_SIZE(ad), NULL, 0);
    if (err) {
        printk("[BLE] bt_le_adv_start failed: %d\n", err);
        return err;
    }
    ble_advertising = true;
    printk("[BLE] Advertising started\n");
    
    /* Initialize face value with current face */
    extern uint8_t munin_imu_get_current_face(void);
    face_value = munin_imu_get_current_face();
    printk("[BLE] Initialized with current face: %u\n", face_value);
    
    return 0;
}

void munin_ble_update(void)
{
    /* Send current face if notifications just got enabled */
    static bool sent_initial_face = false;
    if (face_notif_enabled && ble_connected && s_conn && !sent_initial_face) {
        extern uint8_t munin_imu_get_current_face(void);
        uint8_t current_face = munin_imu_get_current_face();
        if (current_face > 0) {
            face_value = current_face;
            int ret = bt_gatt_notify(s_conn, &munin_svc.attrs[MUNIN_SVC_ATTR_FACE_VALUE], &face_value, sizeof(face_value));
            if (ret == 0) {
                printk("[BLE] Sent current face on notification enable: %u\n", current_face);
                sent_initial_face = true;
            }
        }
    }
    
    /* Reset flag when notifications are disabled */
    if (!face_notif_enabled) {
        sent_initial_face = false;
    }

    /* Handle confirmation sweep sequencing */
    const int64_t debounce_ms = 150; /* wait for batch to finish */
    const uint16_t on_ms = 500;
    const uint16_t off_ms = 500;
    extern void munin_led_face_flash_ms(uint8_t face_id, uint16_t total_ms);

    int64_t now = k_uptime_get();
    if (!s_cseq.active) {
        /* If armed and enough idle time passed, start sequence */
        if (s_cseq.armed && (now - s_cseq.last_rx_ms) >= debounce_ms) {
            s_cseq.active = true;
            s_cseq.in_break = false;
            s_cseq.preflash_done = false;
            /* Snapshot the current face to show immediately */
            extern uint8_t munin_imu_get_current_face(void);
            s_cseq.preflash_face = munin_imu_get_current_face();
            s_cseq.step_ms = now;
            if (s_cseq.preflash_face > 0) {
                /* Instantly reflect the new color on the current face */
                munin_led_face_flash_ms(s_cseq.preflash_face, on_ms);
            } else {
                /* No current face known; skip preflash and start sweep at 1 */
                s_cseq.preflash_done = true;
                s_cseq.next_face = 1;
                munin_led_face_flash_ms(s_cseq.next_face, on_ms);
            }
        }
    } else {
        if (!s_cseq.preflash_done) {
            /* Handle preflash timing: ON then OFF */
            if (!s_cseq.in_break) {
                if ((now - s_cseq.step_ms) >= on_ms) {
                    s_cseq.in_break = true;
                    s_cseq.step_ms = now;
                }
            } else {
                if ((now - s_cseq.step_ms) >= off_ms) {
                    /* Preflash complete; begin 1->6 sweep */
                    s_cseq.preflash_done = true;
                    s_cseq.in_break = false;
                    s_cseq.next_face = 1;
                    s_cseq.step_ms = now;
                    munin_led_face_flash_ms(s_cseq.next_face, on_ms);
                }
            }
        } else {
            if (!s_cseq.in_break) {
                /* ON phase managed by led effects; when elapsed, start break */
                if ((now - s_cseq.step_ms) >= on_ms) {
                    s_cseq.in_break = true;
                    s_cseq.step_ms = now;
                }
            } else {
                /* Break phase; after off_ms, advance to next face or finish */
                if ((now - s_cseq.step_ms) >= off_ms) {
                    if (s_cseq.next_face < 6) {
                        s_cseq.next_face++;
                        s_cseq.in_break = false;
                        s_cseq.step_ms = now;
                        munin_led_face_flash_ms(s_cseq.next_face, on_ms);
                    } else {
                        /* Sequence complete */
                        s_cseq.active = false;
                        s_cseq.armed = false;
                    }
                }
            }
        }
    }
}

int munin_ble_send_data(const uint8_t *data, size_t length)
{
    if (!ble_connected || !s_conn || length == 0) return -1;
    if (length > sizeof(tx_value)) length = sizeof(tx_value);
    memcpy(tx_value, data, length);
    return bt_gatt_notify(s_conn, &munin_svc.attrs[MUNIN_SVC_ATTR_TX_VALUE], tx_value, length);
}

int munin_ble_notify_face(uint8_t face_id)
{
    if (!ble_connected || !s_conn || !face_notif_enabled) return -1;
    face_value = face_id;
    return bt_gatt_notify(s_conn, &munin_svc.attrs[MUNIN_SVC_ATTR_FACE_VALUE], &face_value, sizeof(face_value));
}

bool munin_ble_is_connected(void)
{
    return ble_connected;
}

bool munin_ble_is_advertising(void)
{
    return ble_advertising && !ble_connected;
}
```

## src/ble.h
```c
#ifndef MUNIN_BLE_H
#define MUNIN_BLE_H

#include <stdbool.h>
#include <stddef.h>
#include <stdint.h>

int munin_ble_init(void);
void munin_ble_update(void);
int munin_ble_send_data(const uint8_t *data, size_t length);
bool munin_ble_is_connected(void);
bool munin_ble_is_advertising(void);

/* Notify the current face (1..6). Payload format: [face_id(uint8_t)] */
int munin_ble_notify_face(uint8_t face_id);

#endif
```

## src/debug.h
```c
#ifndef MUNIN_DEBUG_H
#define MUNIN_DEBUG_H

/* Central debug logging toggle. Define MUNIN_DEBUG (e.g. via CFLAGS or here) to enable verbose logs. */
#ifndef MUNIN_DEBUG
#define MUNIN_DEBUG 0
#endif

#if MUNIN_DEBUG
#include <zephyr/sys/printk.h>
#define MLOG(fmt, ...) printk("[DBG] " fmt, ##__VA_ARGS__)
#else
#define MLOG(fmt, ...) do { } while (0)
#endif

#endif /* MUNIN_DEBUG_H */
```

## src/imu.c
```c
#include "imu.h"
#include "munin_protocol.h"
#include "led_effects.h"
#include <zephyr/kernel.h>
#include <zephyr/device.h>
#include <zephyr/drivers/sensor.h>
#include <math.h>
#include "debug.h"

/* Attempt to resolve the IMU device via compatible (preferred) falling back to node label. */
#if DT_HAS_COMPAT_STATUS_OKAY(st_lsm6dsl)
#define IMU_NODE DT_COMPAT_GET_ANY_STATUS_OKAY(st_lsm6dsl)
#elif DT_HAS_COMPAT_STATUS_OKAY(st_lsm6ds3tr_c)
#define IMU_NODE DT_COMPAT_GET_ANY_STATUS_OKAY(st_lsm6ds3tr_c)
#endif

#define IMU_SAMPLE_INTERVAL_MS 180      /* ~5.5 Hz sampling to save power */
#define IMU_SMOOTH_WINDOW      6        /* Moderate smoothing */
#define IMU_MIN_AXIS_G         0.55f    /* Minimum absolute g on dominant axis */
#define IMU_AXIS_MARGIN_G      0.18f    /* Dominance margin over next axis */
#define FACE_SETTLE_TIME_MS    1500     /* Require 1.5s stable before switching face */
/* Removed unused FACE_HYSTERESIS_EXTRA constant (simplified hysteresis logic) */

static const struct device *accel;
static uint8_t s_face;              /* Current accepted face */
static uint8_t s_candidate;         /* Candidate face while settling */
static int64_t s_candidate_since;   /* When candidate was first observed */
static int64_t s_session_start;     /* When current face session started */

/* Smoothing buffers */
static float hist_x[IMU_SMOOTH_WINDOW];
static float hist_y[IMU_SMOOTH_WINDOW];
static float hist_z[IMU_SMOOTH_WINDOW];
static uint8_t hist_index;
static uint8_t hist_count;

static void imu_add_sample(float x, float y, float z)
{
    hist_x[hist_index] = x; hist_y[hist_index] = y; hist_z[hist_index] = z;
    hist_index = (hist_index + 1) % IMU_SMOOTH_WINDOW;
    if (hist_count < IMU_SMOOTH_WINDOW) hist_count++;
}

static void imu_get_average(float *x, float *y, float *z)
{
    float sx=0, sy=0, sz=0;
    for (uint8_t i=0;i<hist_count;i++) { sx += hist_x[i]; sy += hist_y[i]; sz += hist_z[i]; }
    if (hist_count == 0) { *x=*y=*z=0.f; return; }
    *x = sx / hist_count; *y = sy / hist_count; *z = sz / hist_count;
}

/* Map dominant axis & sign -> face id (1..6). Return 0 if unstable/unknown. */
static uint8_t face_from_avg(float x, float y, float z)
{
    float ax = fabsf(x), ay = fabsf(y), az = fabsf(z);
    /* Find largest and second largest magnitudes */
    float max1 = ax, max2 = -1.f; int idx = 0;
    if (ay > max1) { max2 = max1; max1 = ay; idx = 1; } else { max2 = ay; }
    if (az > max1) { max2 = max1; max1 = az; idx = 2; } else if (az > max2) { max2 = az; }
    if (max1 < IMU_MIN_AXIS_G) return 0;
    if ((max1 - max2) < IMU_AXIS_MARGIN_G) return 0;
    switch (idx) {
        case 0: return (x > 0.f) ? 1 : 2; /* X */
        case 1: return (y > 0.f) ? 3 : 4; /* Y */
        default: return (z > 0.f) ? 5 : 6; /* Z */
    }
}

int munin_imu_init(void)
{
#ifdef IMU_NODE
    accel = DEVICE_DT_GET(IMU_NODE);
    printk("IMU: Resolved via compatible IMU_NODE -> %p\n", accel);
#else
    /* Fallback: legacy node label guess */
    accel = DEVICE_DT_GET_OR_NULL(DT_NODELABEL(lsm6ds3tr_c));
    printk("IMU: Fallback node label lookup -> %p\n", accel);
#endif

    if (!accel) {
        printk("IMU: Device struct missing\n");
        return -1;
    }
    if (!device_is_ready(accel)) {
        printk("IMU: Device not ready\n");
        return -1;
    }

    printk("IMU: Device ready, configuring ODR...\n");

    /* Configure accelerometer: 104 Hz, +/- 2g (adjust if needed). */
    struct sensor_value odr = { .val1 = 104, .val2 = 0 };
    int ret = sensor_attr_set(accel, SENSOR_CHAN_ACCEL_XYZ, SENSOR_ATTR_SAMPLING_FREQUENCY, &odr);
    printk("IMU: Set ODR 104Hz -> %d\n", ret);

    /* Full-scale attribute not applied (driver returned -EINVAL previously); skipping. */

    /* Allow sensor to apply settings */
    k_sleep(K_MSEC(50));

    struct sensor_value v[3];
    /* Retry a few times to get non-zero data */
    bool got_nonzero = false;
    for (int attempt=0; attempt<5; attempt++) {
        ret = sensor_sample_fetch(accel);
        if (ret) {
        MLOG("IMU: Sample fetch failed (attempt %d): %d\n", attempt, ret);
            k_sleep(K_MSEC(20));
            continue;
        }
        ret = sensor_channel_get(accel, SENSOR_CHAN_ACCEL_XYZ, v);
        if (ret) {
        MLOG("IMU: Channel get failed (attempt %d): %d\n", attempt, ret);
            k_sleep(K_MSEC(20));
            continue;
        }
        if (v[0].val1 || v[0].val2 || v[1].val1 || v[1].val2 || v[2].val1 || v[2].val2) {
            got_nonzero = true;
            break;
        }
    MLOG("IMU: Still zero readings (attempt %d) ...\n", attempt);
        k_sleep(K_MSEC(30));
    }

    MLOG("IMU: Raw sensor values: [%d.%06d,%d.%06d,%d.%06d] nonzero=%d\n",
          v[0].val1, v[0].val2, v[1].val1, v[1].val2, v[2].val1, v[2].val2, got_nonzero);

    float fx = sensor_value_to_double(&v[0]);
    float fy = sensor_value_to_double(&v[1]);
    float fz = sensor_value_to_double(&v[2]);
    for (int i=0;i<IMU_SMOOTH_WINDOW;i++) imu_add_sample(fx,fy,fz);
    float ax, ay, az; imu_get_average(&ax,&ay,&az);
    s_face = face_from_avg(ax,ay,az);
    if (s_face==0) s_face = 6; /* fallback if flat/unknown at boot */
    s_candidate = s_face;
    s_candidate_since = k_uptime_get();
    s_session_start = s_candidate_since;

    int xmg = (int)(ax * 1000.f);
    int ymg = (int)(ay * 1000.f);
    int zmg = (int)(az * 1000.f);
    printk("IMU: Initial face=%d avg_mg: x=%d y=%d z=%d\n", s_face, xmg, ymg, zmg);

    munin_packet_t pkt; // Boot event (face encoded in face_id)
    munin_protocol_create_packet(&pkt, MUNIN_EVENT_BOOT, 0, s_face);
    munin_protocol_send_packet(&pkt); /* Version packet sent later from main */
    return got_nonzero ? 0 : -2; /* Return -2 if still only zeros */
}

void munin_imu_update(void)
{
    if (!accel) return;
    static int64_t last;
    static int debug_counter = 0;
    int64_t now = k_uptime_get();
    if (now - last < IMU_SAMPLE_INTERVAL_MS) return; // target rate
    last = now;

    struct sensor_value v[3];
    int ret = sensor_sample_fetch(accel);
    if (ret) {
        if (debug_counter % 50 == 0) {
        MLOG("IMU: Sample fetch error: %d\n", ret);
        }
        debug_counter++;
        return;
    }
    ret = sensor_channel_get(accel, SENSOR_CHAN_ACCEL_XYZ, v);
    if (ret) {
        if (debug_counter % 50 == 0) {
        MLOG("IMU: Channel get error: %d\n", ret);
        }
        debug_counter++;
        return;
    }
    
    /* Add new sample to smoothing window */
    float fx = sensor_value_to_double(&v[0]);
    float fy = sensor_value_to_double(&v[1]);
    float fz = sensor_value_to_double(&v[2]);
    imu_add_sample(fx,fy,fz);
    float ax, ay, az; imu_get_average(&ax,&ay,&az);
    uint8_t detected = face_from_avg(ax,ay,az);
    
    // Debug output every 5 seconds
    if (MUNIN_DEBUG && (debug_counter % 30 == 0)) { /* Every ~5.4s (30 * 180ms) */
        int xmg = (int)(ax * 1000.f);
        int ymg = (int)(ay * 1000.f);
        int zmg = (int)(az * 1000.f);
        printk("IMU: avg_mg x=%d y=%d z=%d -> detected=%d current=%d cand=%d t=%lld\n", 
               xmg, ymg, zmg, detected, s_face, s_candidate, (long long)(k_uptime_get() - s_candidate_since));
    }
    debug_counter++;
    
    if (detected != 0) {
        if (detected != s_face) {
            /* If new candidate different from previous candidate, restart timer */
            if (detected != s_candidate) {
                s_candidate = detected;
                s_candidate_since = now;
                MLOG("IMU: New candidate face: %d\n", detected);
            } else {
                /* Check stability duration */
                if ((now - s_candidate_since) >= FACE_SETTLE_TIME_MS) {
                    /* Extra hysteresis: ensure dominance still present with margin */
                    if (detected == face_from_avg(ax, ay, az)) {
                        uint32_t settle_ms = (uint32_t)(now - s_candidate_since);
                        printk("IMU: Face %d -> %d (%u ms)\n", s_face, s_candidate, settle_ms);
                        s_face = s_candidate;
                        s_session_start = now;
                        /* Increase margin slightly after switch to reduce oscillations */
                        /* (We conceptually apply hysteresis by short-circuiting candidate resets below) */
                        /*
                         * Previous implementation sent BOTH a protocol face-switch packet
                         * (over the generic TX characteristic) AND a dedicated face
                         * notification via the face characteristic. The Python client then
                         * processed both, causing duplicate logs and zero-length sessions
                         * (Face changed: X -> X). To eliminate this, we now prefer to send
                         * ONLY ONE update per actual face transition:
                         *   1. Attempt BLE notification (if a client subscribed).
                         *   2. If notify not possible (no connection / not subscribed),
                         *      fall back to protocol packet so a later-connected client can
                         *      still reconstruct history if needed.
                         */
                        extern int munin_ble_notify_face(uint8_t face_id);
                        int notif_ret = munin_ble_notify_face(s_face);
                        if (notif_ret < 0) {
                            munin_packet_t pkt;
                            munin_protocol_create_packet(&pkt, MUNIN_EVENT_FACE_SWITCH, 0, s_face);
                            munin_protocol_send_packet(&pkt);
                        }
                        munin_led_face_flash(s_face);
                    }
                }
            }
        } else {
            /* On stable current face, if candidate differs but dominance weak, reset candidate */
            s_candidate = s_face;
            s_candidate_since = now; /* maintain fresh timestamp */
        }
    }

    uint32_t delta_s = (uint32_t)((now - s_session_start) / 1000);
    if (delta_s && (delta_s % 60) == 0) {
        static uint32_t last_logged = 0;
        if (delta_s != last_logged) {
            last_logged = delta_s;
            munin_packet_t pkt;
            munin_protocol_create_packet(&pkt, MUNIN_EVENT_ONGOING_LOG, delta_s, s_face);
            munin_protocol_send_packet(&pkt);
        }
    }
}

uint8_t munin_imu_get_current_face(void)
{
    return s_face;
}

uint32_t munin_imu_get_session_delta_s(void)
{
    int64_t now = k_uptime_get();
    if (now < s_session_start) return 0;
    return (uint32_t)((now - s_session_start) / 1000);
}
```

## src/led_config.c
```c
#include "led_config.h"

/* Runtime face colors initialized with defaults 
 * NOTE: These are initial fallback values only. The actual colors come from 
 * the client configuration via BLE. See munin_client/config.py for the 
 * authoritative default values.
 */
static munin_rgb_t s_face_colors[6] = {
    {255,   0,   0}, // Face 1: Red
    {  0, 255,   0}, // Face 2: Green  
    {  0,   0, 255}, // Face 3: Blue
    {255, 255,   0}, // Face 4: Yellow
    {255,   0, 255}, // Face 5: Magenta
    {128, 128, 128}, // Face 6: Gray
};

const munin_rgb_t *munin_led_get_face_colors(void)
{
    return s_face_colors;
}

void munin_led_set_face_color(uint8_t face, uint8_t r, uint8_t g, uint8_t b)
{
    if (face < 1 || face > 6) return;
    s_face_colors[face - 1].r = r;
    s_face_colors[face - 1].g = g;
    s_face_colors[face - 1].b = b;
}
```

## src/led_config.h
```c
// Local firmware LED color configuration (per face)
#ifndef MUNIN_LED_CONFIG_H
#define MUNIN_LED_CONFIG_H

#include <stdint.h>

typedef struct {
    uint8_t r, g, b;
} munin_rgb_t;

/* Returns pointer to array[6] of face colors (index 0 => face1). */
const munin_rgb_t *munin_led_get_face_colors(void);

/* Update a single face color at runtime (face in 1..6). */
void munin_led_set_face_color(uint8_t face, uint8_t r, uint8_t g, uint8_t b);

#endif
```

## src/led_effects.c
```c
#include "led_effects.h"
#include "led_config.h"
#include "sk6812.h"
#include <zephyr/kernel.h>
#include <zephyr/drivers/gpio.h>

#include <zephyr/device.h>
#include "debug.h"



#define LED0_NODE DT_ALIAS(led0)
#define LED1_NODE DT_ALIAS(led1)
#define LED2_NODE DT_ALIAS(led2)
static const struct gpio_dt_spec led_red = GPIO_DT_SPEC_GET(LED0_NODE, gpios);
static const struct gpio_dt_spec led_green = GPIO_DT_SPEC_GET(LED1_NODE, gpios);
static const struct gpio_dt_spec led_blue = GPIO_DT_SPEC_GET(LED2_NODE, gpios);

static led_target_t s_led_target = LED_TARGET_SK6812;

void munin_led_set_target(led_target_t target) {
    s_led_target = target;
}

led_target_t munin_led_get_target(void) {
    return s_led_target;
}

/* Set RGB LED color based on face */
static void set_led_color(uint8_t face_id, bool on)
{
    const munin_rgb_t *colors = munin_led_get_face_colors();
    munin_rgb_t color = {0, 0, 0};
    if (on && face_id >= 1 && face_id <= 6) {
        color = colors[face_id - 1];
    }
    if (s_led_target == LED_TARGET_SK6812 && sk6812_is_ready()) {
        sk6812_set_rgb(color.r, color.g, color.b);
        gpio_pin_set_dt(&led_red, 0);
        gpio_pin_set_dt(&led_green, 0);
        gpio_pin_set_dt(&led_blue, 0);
        return;
    }

    gpio_pin_set_dt(&led_red, color.r > 0 ? 1 : 0);
    gpio_pin_set_dt(&led_green, color.g > 0 ? 1 : 0);
    gpio_pin_set_dt(&led_blue, color.b > 0 ? 1 : 0);

    if (sk6812_is_ready()) {
        sk6812_set_rgb(0, 0, 0);
    }
}

static struct {
    uint8_t active;      /* 1 if a flash in progress */
    int64_t start_ms;    /* when flash started */
    uint8_t face;        /* face being flashed */
    uint16_t total_ms;   /* total duration of flash */
} s_flash;

/* Flash durations */
#define FLASH_TOTAL_MS 2000  /* 2 seconds flash duration */

int munin_led_effects_init(void)
{
    s_led_target = LED_TARGET_SK6812;
    sk6812_init();
    if (!sk6812_is_ready()) {
        printk("LED: SK6812 unavailable, using onboard RGB\n");
        s_led_target = LED_TARGET_ONBOARD_RGB;
    } else {
        sk6812_set_rgb(0, 0, 0);
        printk("LED: Using SK6812 on D6\n");
    }

    int ret = 0;
    if (!gpio_is_ready_dt(&led_red) || !gpio_is_ready_dt(&led_green) || !gpio_is_ready_dt(&led_blue)) {
        printk("LED: Onboard RGB GPIO not ready\n");
        // Don't fail, just warn
    } else {
        ret = gpio_pin_configure_dt(&led_red, GPIO_OUTPUT_INACTIVE);
        ret |= gpio_pin_configure_dt(&led_green, GPIO_OUTPUT_INACTIVE);
        ret |= gpio_pin_configure_dt(&led_blue, GPIO_OUTPUT_INACTIVE);
        if (ret < 0) {
            printk("LED: Failed to configure onboard RGB\n");
        }
    }
    printk("LED: target=%d (ready=%d)\n", s_led_target, sk6812_is_ready());
    return 0;
}

void munin_led_face_flash(uint8_t face_id)
{
    MLOG("LED: Flash start face=%d t=%lld\n", face_id, k_uptime_get());
    s_flash.active = 1;
    s_flash.start_ms = k_uptime_get();
    s_flash.face = face_id;
    s_flash.total_ms = FLASH_TOTAL_MS;
    
    /* Turn on the LED with face color */
    set_led_color(face_id, true);
    MLOG("LED: Set color face=%d\n", face_id);
}

void munin_led_face_flash_ms(uint8_t face_id, uint16_t total_ms)
{
    if (total_ms == 0) total_ms = 1; /* avoid zero */
    MLOG("LED: Flash(ms) start face=%d dur=%u t=%lld\n", face_id, total_ms, k_uptime_get());
    s_flash.active = 1;
    s_flash.start_ms = k_uptime_get();
    s_flash.face = face_id;
    s_flash.total_ms = total_ms;
    set_led_color(face_id, true);
}

void munin_led_effects_update(void)
{
    if (!s_flash.active) return;
    
    int64_t now = k_uptime_get();
    int64_t elapsed = now - s_flash.start_ms;
    
    uint16_t dur = s_flash.total_ms ? s_flash.total_ms : FLASH_TOTAL_MS;
    if (elapsed >= dur) {
        s_flash.active = 0;
        set_led_color(s_flash.face, false);  /* Turn OFF all LEDs */
    MLOG("LED: Flash end t=%lld dur=%lld\n", now, elapsed);
        return;
    }
    
    /* Simple pulse: on for first 60% then off */
    if (elapsed < (dur * 6 / 10)) {
        set_led_color(s_flash.face, true);   /* Turn ON with face color */
    } else {
        set_led_color(s_flash.face, false);  /* Turn OFF */
    }
}
```

## src/led_effects.h
```c
// LED effects: simple face-change flash
#ifndef MUNIN_LED_EFFECTS_H
#define MUNIN_LED_EFFECTS_H

#include <stdint.h>


typedef enum {
	LED_TARGET_ONBOARD_RGB = 0,
	LED_TARGET_SK6812 = 1,
} led_target_t;

void munin_led_set_target(led_target_t target);
led_target_t munin_led_get_target(void);

int munin_led_effects_init(void);
void munin_led_effects_update(void); /* call periodically */
void munin_led_face_flash(uint8_t face_id); /* trigger flash */
void munin_led_face_flash_ms(uint8_t face_id, uint16_t total_ms);

#endif
```

## src/munin_protocol.h
```c
#ifndef MUNIN_PROTOCOL_H
#define MUNIN_PROTOCOL_H

#include <stdint.h>

#define MUNIN_PACKET_SIZE 6

// Event types
#define MUNIN_EVENT_FACE_SWITCH        0x01
#define MUNIN_EVENT_ONGOING_LOG        0x02
#define MUNIN_EVENT_STATE_SYNC         0x03
#define MUNIN_EVENT_BATTERY_STATUS     0x04  /* Voltage + % + charging flag (periodic) */
#define MUNIN_EVENT_VERSION            0x05  /* Firmware version (sent once after boot) */

#define MUNIN_EVENT_BOOT               0x10
#define MUNIN_EVENT_SHUTDOWN           0x11
#define MUNIN_EVENT_LOW_BATTERY        0x12  /* First time we dip below low threshold */
#define MUNIN_EVENT_CHARGING_STARTED   0x13
#define MUNIN_EVENT_FULLY_CHARGED      0x14
#define MUNIN_EVENT_CHARGING_STOPPED   0x15  /* USB removed before full OR after full */

typedef struct {
    uint8_t event_type;
    uint32_t delta_s;
    uint8_t face_id;
} __attribute__((packed)) munin_packet_t;

int munin_protocol_create_packet(munin_packet_t *packet, uint8_t event_type, uint32_t delta_s, uint8_t face_id);
int munin_protocol_send_packet(const munin_packet_t *packet);

#endif
```

## src/sk6812.c
```c
// Minimal SK6812 (NeoPixel) 1-pixel driver for Zephyr (bit-banged)
#include "sk6812.h"
#include <zephyr/devicetree.h>
#include <zephyr/device.h>
#include <zephyr/drivers/gpio.h>
#include <zephyr/kernel.h>

#define SK6812_T0H_NS  300  // 0 bit, high time (ns)
#define SK6812_T1H_NS  600  // 1 bit, high time (ns)
#define SK6812_T0L_NS  900  // 0 bit, low time (ns)
#define SK6812_T1L_NS  600  // 1 bit, low time (ns)
#define SK6812_RESET_US 80  // Reset pulse (us)

static const struct device *const sk6812_gpio_dev = DEVICE_DT_GET(DT_NODELABEL(gpio1));
static int sk6812_init_ok = 0;

void sk6812_init(void) {
    if (sk6812_init_ok) {
        return;
    }
    printk("SK6812: init start (pin %d)\n", SK6812_PIN);
    if (!device_is_ready(sk6812_gpio_dev)) {
        printk("SK6812: GPIO device not ready\n");
        return;
    }
    int ret = gpio_pin_configure(sk6812_gpio_dev, SK6812_PIN, GPIO_OUTPUT_INACTIVE);
    if (ret != 0) {
        printk("SK6812: gpio_pin_configure failed for pin %d (ret=%d)\n", SK6812_PIN, ret);
        return;
    }
    sk6812_init_ok = 1;
    printk("SK6812: init OK on pin %d\n", SK6812_PIN);
}

static void sk6812_delay_ns(uint32_t ns) {
    // Zephyr doesn't provide sub-us delay, so use busy-wait loop
    // This is not precise, but works for a single LED at low clock speeds
    volatile uint32_t count = ns / 10;
    while (count--) {
        __asm__ volatile ("nop");
    }
}

static void sk6812_write_byte(uint8_t byte) {
    for (int i = 7; i >= 0; i--) {
        if (byte & (1 << i)) {
            gpio_pin_set(sk6812_gpio_dev, SK6812_PIN, 1);
            sk6812_delay_ns(SK6812_T1H_NS);
            gpio_pin_set(sk6812_gpio_dev, SK6812_PIN, 0);
            sk6812_delay_ns(SK6812_T1L_NS);
        } else {
            gpio_pin_set(sk6812_gpio_dev, SK6812_PIN, 1);
            sk6812_delay_ns(SK6812_T0H_NS);
            gpio_pin_set(sk6812_gpio_dev, SK6812_PIN, 0);
            sk6812_delay_ns(SK6812_T0L_NS);
        }
    }
}

void sk6812_set_rgb(uint8_t r, uint8_t g, uint8_t b) {
    sk6812_init();
    if (!sk6812_init_ok) {
        printk("SK6812: set_rgb skipped (init failed)\n");
        return;
    }
    printk("SK6812: set_rgb %d,%d,%d\n", r, g, b);
    unsigned int key = irq_lock();
    // SK6812 expects GRB order
    sk6812_write_byte(g);
    sk6812_write_byte(r);
    sk6812_write_byte(b);
    irq_unlock(key);
    k_busy_wait(SK6812_RESET_US); // Reset
}

bool sk6812_is_ready(void) {
    return sk6812_init_ok != 0;
}
```
