## CMakeLists.txt
```
cmake_minimum_required(VERSION 3.20.0)

find_package(Zephyr REQUIRED HINTS $ENV{ZEPHYR_BASE})
project(munin)

target_sources(app PRIVATE src/main.c)
target_sources(app PRIVATE src/munin_protocol.c)
target_sources(app PRIVATE src/ble.c)
target_sources(app PRIVATE src/imu.c)
target_sources(app PRIVATE src/battery.c)
```

## west.yml
```
manifest:
  self:
  path: app

  remotes:
    - name: zephyrproject-rtos
      url-base: https://github.com/zephyrproject-rtos

  projects:
    - name: zephyr
      remote: zephyrproject-rtos
      revision: main
      import: true
```

## prj.conf
```kconfig
# GPIO (blink etc.)
CONFIG_GPIO=y

# USB device + CDC ACM (LEGACY stack)
CONFIG_USB_DEVICE_STACK=y
CONFIG_USB_DEVICE_STACK_NEXT=n
CONFIG_USB_DEVICE_INITIALIZE_AT_BOOT=y
CONFIG_USB_CDC_ACM=y

# Console routed to the CDC ACM UART via chosen node
CONFIG_CONSOLE=y
CONFIG_PRINTK=y
CONFIG_SERIAL=y
CONFIG_UART_LINE_CTRL=y
CONFIG_UART_CONSOLE=y

# BLE
CONFIG_BT=y
CONFIG_BT_PERIPHERAL=y
CONFIG_BT_DEVICE_NAME="Munin"

# GATT
CONFIG_BT_GATT_CLIENT=y
CONFIG_BT_SETTINGS=y

# Sensors (IMU)
CONFIG_I2C=y
CONFIG_SENSOR=y
CONFIG_LSM6DSL=y

# Logging
CONFIG_LOG=y
CONFIG_LOG_DEFAULT_LEVEL=3
```

## app.overlay
```dts
/*
 * USB CDC console configuration
 */

/ {
	chosen {
		zephyr,console = &board_cdc_acm_uart;
		zephyr,log-backend = &board_cdc_acm_uart;
	};
};

&usbd {
	status = "okay";
};

&board_cdc_acm_uart {
	status = "okay";
};
```

## src/main.c
```c
#include <zephyr/kernel.h>
#include <zephyr/drivers/gpio.h>
#include <zephyr/sys/printk.h>
#include <zephyr/drivers/uart.h>
#include <zephyr/device.h>
#include <zephyr/devicetree.h>

#include "ble.h"
#include "imu.h"
#include "battery.h"
#include "munin_protocol.h"

/* Use the red LED (led0) */
#define LED0_NODE DT_ALIAS(led0)
static const struct gpio_dt_spec red_led = GPIO_DT_SPEC_GET(LED0_NODE, gpios);

static void wait_for_dtr(const struct device *dev) {
#ifdef CONFIG_UART_LINE_CTRL
	uint32_t dtr = 0;
	(void)uart_line_ctrl_set(dev, UART_LINE_CTRL_DTR, 1);
	do {
		(void)uart_line_ctrl_get(dev, UART_LINE_CTRL_DTR, &dtr);
		k_msleep(50);
	} while (!dtr);
#endif
}

int main(void)
{
	const struct device *console = DEVICE_DT_GET_OR_NULL(DT_CHOSEN(zephyr_console));
	int ret;

	printk("*** Munin (Zephyr) starting on %s ***\n", CONFIG_BOARD);
	printk("Console: %p\n", console);

	if (!gpio_is_ready_dt(&red_led)) {
		printk("LED not ready\n");
		return -1;
	}
	ret = gpio_pin_configure_dt(&red_led, GPIO_OUTPUT_ACTIVE);
	if (ret) return ret;

	if (console && device_is_ready(console)) {
		wait_for_dtr(console);
	}
	printk("Console ready. Initializing subsystems...\n");

	// Init subsystems
	if (munin_battery_init()) printk("Battery init failed\n");
	if (munin_imu_init()) printk("IMU init failed\n");
	if (munin_ble_init()) printk("BLE init failed\n");

	// Main loop
	bool led = true;
	int counter = 0;
	while (1) {
		// Show face-based LED behavior (less annoying)
		uint8_t current_face = munin_imu_get_current_face();
		if (current_face == 0) {
			// Face 0 (unknown/flat) - slow blink (once every 2 seconds)
			if ((counter % 4) == 0) {
				led = !led;
			}
			gpio_pin_set_dt(&red_led, (int)led);
		} else {
			// For detected faces 1-6, show solid LED (no blinking)
			gpio_pin_set_dt(&red_led, 1);
		}
		
		printk("tick %d face=%u batt=%u%% conn=%d\n", counter++, current_face,
			   munin_battery_get_percentage(), munin_ble_is_connected());

		munin_battery_update();
		munin_imu_update();
		munin_ble_update();

		k_sleep(K_MSEC(500));
	}
	return 0;
}
```

## src/battery.c
```c
#include "battery.h"
#include "munin_protocol.h"
#include <zephyr/kernel.h>
#include <zephyr/pm/device.h>

static uint16_t s_mv = 4000;
static uint8_t s_pct = 100;
static bool s_chg = false;

int munin_battery_init(void)
{
    // TODO: wire real ADC + charger GPIO when ready
    return 0;
}

void munin_battery_update(void)
{
    static int64_t last;
    int64_t now = k_uptime_get();
    if (now - last < 30000) return; // 30s
    last = now;

    // Placeholder behavior: assume USB present => charging
    bool chg_now = s_chg; // keep state for eventing later when real signals exist
    if (chg_now != s_chg) {
        s_chg = chg_now;
        munin_packet_t pkt;
        munin_protocol_create_packet(&pkt, s_chg ? MUNIN_EVENT_CHARGING_START : MUNIN_EVENT_CHARGING_STOP, 0, 0);
        munin_protocol_send_packet(&pkt);
    }

    if (s_mv <= 3500) {
        munin_packet_t pkt;
        munin_protocol_create_packet(&pkt, MUNIN_EVENT_LOW_BATTERY, 0, 0);
        munin_protocol_send_packet(&pkt);
    }
}

uint16_t munin_battery_get_voltage_mv(void) { return s_mv; }
uint8_t munin_battery_get_percentage(void) { return s_pct; }
bool munin_battery_is_charging(void) { return s_chg; }
```

## src/battery.h
```c
#ifndef BATTERY_H
#define BATTERY_H

#include <stdint.h>
#include <stdbool.h>

// Function prototypes
int munin_battery_init(void);
void munin_battery_update(void);
uint16_t munin_battery_get_voltage_mv(void);
uint8_t munin_battery_get_percentage(void);
bool munin_battery_is_charging(void);
bool munin_battery_is_connected(void);

#endif // BATTERY_H
```

## src/ble.c
```c
#include "ble.h"
#include <zephyr/kernel.h>
#include <zephyr/bluetooth/bluetooth.h>
#include <zephyr/bluetooth/hci.h>
#include <zephyr/bluetooth/conn.h>
#include <zephyr/bluetooth/uuid.h>
#include <zephyr/bluetooth/gatt.h>

// UUIDs (random custom)
#define MUNIN_SVC_UUID    BT_UUID_128_ENCODE(0x6e400001, 0x8a3a, 0x11e5, 0x8994, 0xfeff819cdc9f)
#define MUNIN_TX_UUID     BT_UUID_128_ENCODE(0x6e400002, 0x8a3a, 0x11e5, 0x8994, 0xfeff819cdc9f)
#define MUNIN_LED_UUID    BT_UUID_128_ENCODE(0x6e400003, 0x8a3a, 0x11e5, 0x8994, 0xfeff819cdc9f)

static struct bt_uuid_128 svc_uuid = BT_UUID_INIT_128(MUNIN_SVC_UUID);
static struct bt_uuid_128 tx_uuid  = BT_UUID_INIT_128(MUNIN_TX_UUID);
static struct bt_uuid_128 led_uuid = BT_UUID_INIT_128(MUNIN_LED_UUID);

static struct bt_conn *s_conn;
static uint8_t tx_value[6];
static bool ble_connected;

static ssize_t read_tx(struct bt_conn *conn, const struct bt_gatt_attr *attr, void *buf,
                       uint16_t len, uint16_t offset)
{
    return bt_gatt_attr_read(conn, attr, buf, len, offset, tx_value, sizeof(tx_value));
}

static ssize_t write_led(struct bt_conn *conn, const struct bt_gatt_attr *attr,
                         const void *buf, uint16_t len, uint16_t offset, uint8_t flags)
{
    ARG_UNUSED(attr);
    // Expect 4 bytes: face_id, r, g, b
    if (len == 4) {
        // TODO: store LED config and show feedback via LED
    }
    return len;
}

BT_GATT_SERVICE_DEFINE(munin_svc,
    BT_GATT_PRIMARY_SERVICE(&svc_uuid),
    BT_GATT_CHARACTERISTIC(&tx_uuid.uuid,
                           BT_GATT_CHRC_READ | BT_GATT_CHRC_NOTIFY,
                           BT_GATT_PERM_READ,
                           read_tx, NULL, tx_value),
    BT_GATT_CCC(NULL, BT_GATT_PERM_READ | BT_GATT_PERM_WRITE),
    BT_GATT_CHARACTERISTIC(&led_uuid.uuid,
                           BT_GATT_CHRC_WRITE,
                           BT_GATT_PERM_WRITE,
                           NULL, write_led, NULL),
);

static void connected(struct bt_conn *conn, uint8_t err)
{
    if (err) {
        return;
    }
    s_conn = bt_conn_ref(conn);
    ble_connected = true;
}

static void disconnected(struct bt_conn *conn, uint8_t reason)
{
    ARG_UNUSED(conn);
    ARG_UNUSED(reason);
    if (s_conn) {
        bt_conn_unref(s_conn);
        s_conn = NULL;
    }
    ble_connected = false;
}

BT_CONN_CB_DEFINE(conn_cbs) = {
    .connected = connected,
    .disconnected = disconnected,
};

static const struct bt_data ad[] = {
    BT_DATA_BYTES(BT_DATA_FLAGS, (BT_LE_AD_GENERAL | BT_LE_AD_NO_BREDR)),
    BT_DATA(BT_DATA_NAME_COMPLETE, CONFIG_BT_DEVICE_NAME, sizeof(CONFIG_BT_DEVICE_NAME) - 1),
    BT_DATA_BYTES(BT_DATA_UUID128_ALL, MUNIN_SVC_UUID),
};

int munin_ble_init(void)
{
    int err = bt_enable(NULL);
    if (err) return err;
    return bt_le_adv_start(BT_LE_ADV_CONN_NAME, ad, ARRAY_SIZE(ad), NULL, 0);
}

void munin_ble_update(void)
{
    // Placeholder for future updates
}

int munin_ble_send_data(const uint8_t *data, size_t length)
{
    if (!ble_connected || !s_conn || length == 0) return -1;
    if (length > sizeof(tx_value)) length = sizeof(tx_value);
    memcpy(tx_value, data, length);
    return bt_gatt_notify(s_conn, &munin_svc.attrs[1], tx_value, length);
}

bool munin_ble_is_connected(void)
{
    return ble_connected;
}
```

## src/ble.h
```c
#ifndef MUNIN_BLE_H
#define MUNIN_BLE_H

#include <stdbool.h>
#include <stddef.h>
#include <stdint.h>

int munin_ble_init(void);
void munin_ble_update(void);
int munin_ble_send_data(const uint8_t *data, size_t length);
bool munin_ble_is_connected(void);

#endif
```

## src/imu.c
```c
#include "imu.h"
#include "munin_protocol.h"
#include <zephyr/kernel.h>
#include <zephyr/device.h>
#include <zephyr/drivers/sensor.h>
#include <math.h>

#define FACE_SETTLE_TIME_MS 1500

static const struct device *accel;
static uint8_t s_face;
static uint8_t s_candidate;
static int64_t s_candidate_since;
static int64_t s_session_start;

static uint8_t face_from_accel(const struct sensor_value *v)
{
    double x = sensor_value_to_double(&((struct sensor_value *)v)[0]);
    double y = sensor_value_to_double(&((struct sensor_value *)v)[1]);
    double z = sensor_value_to_double(&((struct sensor_value *)v)[2]);
    double ax = fabs(x), ay = fabs(y), az = fabs(z);
    if (ax > ay && ax > az) return (x > 0) ? 1 : 2;
    if (ay > ax && ay > az) return (y > 0) ? 3 : 4;
    return (z > 0) ? 5 : 0;
}

int munin_imu_init(void)
{
    accel = DEVICE_DT_GET_ONE(st_lsm6dsl);
    if (!accel || !device_is_ready(accel)) return -1;
    k_sleep(K_MSEC(50));
    struct sensor_value v[3];
    if (sensor_sample_fetch(accel) || sensor_channel_get(accel, SENSOR_CHAN_ACCEL_XYZ, v)) return -1;
    s_face = s_candidate = face_from_accel(v);
    s_candidate_since = k_uptime_get();
    s_session_start = s_candidate_since;

    munin_packet_t pkt; // Boot event
    munin_protocol_create_packet(&pkt, MUNIN_EVENT_BOOT, 0, s_face);
    munin_protocol_send_packet(&pkt);
    return 0;
}

void munin_imu_update(void)
{
    if (!accel) return;
    static int64_t last;
    int64_t now = k_uptime_get();
    if (now - last < 100) return; // 10 Hz
    last = now;

    struct sensor_value v[3];
    if (sensor_sample_fetch(accel) || sensor_channel_get(accel, SENSOR_CHAN_ACCEL_XYZ, v)) return;
    uint8_t detected = face_from_accel(v);
    if (detected != s_candidate) {
        s_candidate = detected;
        s_candidate_since = now;
        return;
    }
    if (s_candidate != s_face && (now - s_candidate_since) >= FACE_SETTLE_TIME_MS) {
        s_face = s_candidate;
        s_session_start = now;
        munin_packet_t pkt;
        munin_protocol_create_packet(&pkt, MUNIN_EVENT_FACE_SWITCH, 0, s_face);
        munin_protocol_send_packet(&pkt);
    } else {
        uint32_t delta_s = (uint32_t)((now - s_session_start) / 1000);
        if (delta_s && (delta_s % 60) == 0) {
            munin_packet_t pkt;
            munin_protocol_create_packet(&pkt, MUNIN_EVENT_ONGOING_LOG, delta_s, s_face);
            munin_protocol_send_packet(&pkt);
        }
    }
}

uint8_t munin_imu_get_current_face(void)
{
    return s_face;
}

uint32_t munin_imu_get_session_delta_s(void)
{
    int64_t now = k_uptime_get();
    if (now < s_session_start) return 0;
    return (uint32_t)((now - s_session_start) / 1000);
}
```

## src/imu.h
```c
#ifndef MUNIN_IMU_H
#define MUNIN_IMU_H

#include <stdint.h>

#define MUNIN_FACE_COUNT 6

int munin_imu_init(void);
void munin_imu_update(void);
uint8_t munin_imu_get_current_face(void);
uint32_t munin_imu_get_session_delta_s(void);

#endif
```

## src/munin_protocol.c
```c
#include "munin_protocol.h"
#include "ble.h"
#include <string.h>

int munin_protocol_create_packet(munin_packet_t *packet, uint8_t event_type, uint32_t delta_s, uint8_t face_id)
{
    if (!packet) return -1;
    packet->event_type = event_type;
    packet->delta_s = delta_s;
    packet->face_id = face_id;
    return 0;
}

int munin_protocol_send_packet(const munin_packet_t *packet)
{
    if (!packet) return -1;
    uint8_t wire[MUNIN_PACKET_SIZE];
    wire[0] = packet->event_type;
    wire[1] = (uint8_t)(packet->delta_s & 0xFF);
    wire[2] = (uint8_t)((packet->delta_s >> 8) & 0xFF);
    wire[3] = (uint8_t)((packet->delta_s >> 16) & 0xFF);
    wire[4] = (uint8_t)((packet->delta_s >> 24) & 0xFF);
    wire[5] = packet->face_id;
    return munin_ble_send_data(wire, sizeof(wire));
}
```

## src/munin_protocol.h
```c
#ifndef MUNIN_PROTOCOL_H
#define MUNIN_PROTOCOL_H

#include <stdint.h>

// Munin Protocol v2.0 - 6-byte packet format
#define MUNIN_PACKET_SIZE 6

// Event types
#define MUNIN_EVENT_FACE_SWITCH    0x01  // Face changed (delta_s = 0)
#define MUNIN_EVENT_ONGOING_LOG    0x02  // Time elapsed on same face
#define MUNIN_EVENT_STATE_SYNC     0x03  // Connection state sync
#define MUNIN_EVENT_BOOT          0x10  // Device powered on
#define MUNIN_EVENT_SHUTDOWN      0x11  // Device shutting down
#define MUNIN_EVENT_LOW_BATTERY   0x12  // Battery low warning
#define MUNIN_EVENT_CHARGING_START 0x13  // Charging started
#define MUNIN_EVENT_CHARGING_FULL 0x14  // Charging complete
#define MUNIN_EVENT_CHARGING_STOP 0x15  // Charging stopped

// Packet structure
typedef struct {
    uint8_t event_type;
    uint32_t delta_s;    // Little-endian
    uint8_t face_id;
} __attribute__((packed)) munin_packet_t;

// Function prototypes
int munin_protocol_create_packet(munin_packet_t *packet, uint8_t event_type, uint32_t delta_s, uint8_t face_id);
int munin_protocol_send_packet(const munin_packet_t *packet);

#endif // MUNIN_PROTOCOL_H
```
